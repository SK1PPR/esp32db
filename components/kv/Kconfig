## components/kv/Kconfig
```kconfig
menu "Key/value engine"

    choice KV_ENGINE
        prompt "Storage engine behind the kv:: API"
        default KV_ENGINE_ESP32DB
        help
            One engine per firmware image. esp32db is this project's database;
            the others exist so tools/bench.py can compare against them on
            identical boards (see bench/sdkconfig.*).

        config KV_ENGINE_ESP32DB
            bool "esp32db (B+ tree + log, this project)"
        config KV_ENGINE_FLASHDB
            bool "FlashDB KVDB on raw flash (benchmark)"
        config KV_ENGINE_SQLITE
            bool "SQLite on FATFS + wear levelling (benchmark)"
    endchoice

endmenu
```

## components/net/Kconfig
```kconfig
menu "Networking"

    config NET_WIFI
        bool "WiFi station"
        default n
        help
            Bring up the WiFi driver at boot (credentials from `wifi set`).
            Off: net:: is compiled as stubs that report "off", the WiFi
            driver isn't linked, and the RAM it would take at init goes to
            the database balloon instead. Turn on for the distributed
            database work.

endmenu
```
